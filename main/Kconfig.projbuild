## main/Kconfig.projbuild
```kconfig
menu "Air Q Configuration"

    menu "SoftAP Configuration"
        comment "SoftAP Configuration"

        config ESP_WIFI_AP_SSID
            string "WiFi AP SSID"
            default "myssid"
            help
                SSID (network name) of the AP for the example to connect to.

        config ESP_WIFI_AP_PASSWORD
            string "WiFi AP Password"
            default "mypassword"
            help
                WiFi password of the AP for the example to use.

        config ESP_WIFI_AP_CHANNEL
            int "WiFi AP Channel"
            range 1 14
            default 1
            help
                WiFi channel (network channel) of the AP for the example to use.

        config ESP_MAX_STA_CONN_AP
            int "Maximal STA connections"
            default 4
            help
                Max number of the STA connects to AP.
    endmenu

    menu "STA Configuration"
        comment "STA Configuration"

        config WIFI_SSID
            string "WiFi SSID"
            default "myssid"
            help
                SSID (network name) for the example to connect to.

        config WIFI_PASSWORD
            string "WiFi Password"
            default "mypassword"
            help
                WiFi password (WPA or WPA2) for the example to use.

        config ESP_MAXIMUM_STA_RETRY
            int "Maximum retry"
            default 5
            help
                Set the maximum retry value to prevent the station from continuously
                attempting to reconnect to the Access Point (AP) when the AP doesn't exist.

        choice SCAN_METHOD
            prompt "scan method"
            default WIFI_FAST_SCAN
            help
                scan method for the esp32 to use

            config WIFI_FAST_SCAN
                bool "fast"
            config WIFI_ALL_CHANNEL_SCAN
                bool "all"
        endchoice

        choice SORT_METHOD
            prompt "sort method"
            default WIFI_CONNECT_AP_BY_SIGNAL
            help
                sort method for the esp32 to use

            config WIFI_CONNECT_AP_BY_SIGNAL
                bool "rssi"
            config WIFI_CONNECT_AP_BY_SECURITY
                bool "authmode"
        endchoice

        config FAST_SCAN_THRESHOLD
            bool "fast scan threshold"
            default y
            help
                wifi fast scan threshold

        config FAST_SCAN_MINIMUM_SIGNAL
            int "fast scan minimum rssi"
            depends on FAST_SCAN_THRESHOLD
            range -127 0
            default -127
            help
                rssi is use to measure the signal

        choice FAST_SCAN_WEAKEST_AUTHMODE
            prompt "fast scan weakest authmode"
            depends on FAST_SCAN_THRESHOLD
            default FAST_SCAN_WEAKEST_AUTHMODE_OPEN

            config FAST_SCAN_WEAKEST_AUTHMODE_OPEN
                bool "open"
            config FAST_SCAN_WEAKEST_AUTHMODE_WEP
                bool "wep"
            config FAST_SCAN_WEAKEST_AUTHMODE_WPA
                bool "wpa"
            config FAST_SCAN_WEAKEST_AUTHMODE_WPA2
                bool "wpa2"
        endchoice

        config FAST_SCAN_RSSI_5G_ADJUSTMENT
            int "fast scan rssi 5g adjustment"
            depends on FAST_SCAN_THRESHOLD && SOC_WIFI_SUPPORT_5G
            range 0 128
            default 10
            help
                It is used to compensate for the signal difference between 2G and 5G, allowing
                the STA to prioritize connecting to the 5G AP

    endmenu
endmenu
```
